## boards/arm/freepad_n52840/Kconfig.defconfig
```kconfig
# Copyright (c) 2024 Nordic Semiconductor ASA
# SPDX-License-Identifier: Apache-2.0

if BOARD_FREEPAD_N52840

config BOARD
	default "freepad_n52840"

config BT_CTLR
   default BT


endif
```

## boards/arm/freepad_nrf52840/Kconfig.board
```kconfig
# nRF52840 MDK USB Dongle board configuration

# Copyright (c) 2022 Nikola Trifunovic
# Copyright (c) 2018 Nordic Semiconductor ASA
# SPDX-License-Identifier: Apache-2.0

config BOARD_FREEPAD_NRF52840
	bool "freepad nRF52840"
	depends on SOC_NRF52840_QIAA
```
